## CMakeLists.txt
```
cmake_minimum_required(VERSION 3.20.0)
find_package(Zephyr REQUIRED HINTS $ENV{ZEPHYR_BASE})
project(Zephyr_ESP32_WiFi_MQTT)

target_sources(app PRIVATE
    src/main.c
    src/ping.c
    src/tb_mqtt.c
    
)
```

## prj.conf
```kconfig
CONFIG_SERIAL=y
CONFIG_CONSOLE=y
CONFIG_UART_CONSOLE=y
CONFIG_PRINTK=y

CONFIG_NETWORKING=y
CONFIG_NET_IPV4=y
CONFIG_NET_DHCPV4=y
CONFIG_DNS_RESOLVER=y

CONFIG_NET_TCP=y
CONFIG_NET_UDP=y
CONFIG_NET_CONNECTION_MANAGER=y

CONFIG_POSIX_API=y

CONFIG_WIFI=y
CONFIG_NET_L2_WIFI_MGMT=y

CONFIG_NET_SOCKETS=y
CONFIG_MQTT_LIB=y

CONFIG_NET_MGMT=y
CONFIG_NET_MGMT_EVENT=y
CONFIG_NET_MGMT_EVENT_INFO=y

CONFIG_MAIN_STACK_SIZE=4096
```

## src/main.c
```c
#include <string.h>
#include <stdbool.h>
#include <stdint.h>

#include <zephyr/kernel.h>
#include <zephyr/sys/printk.h>

#include <zephyr/net/net_if.h>
#include <zephyr/net/net_mgmt.h>
#include <zephyr/net/net_event.h>
#include <zephyr/net/wifi_mgmt.h>
#include <zephyr/net/dhcpv4.h>
#include <zephyr/net/net_ip.h>

#include "ping.h"
#include "tb_mqtt.h"

#include <zephyr/net/socket.h>
#include <errno.h>

/* ThingsBoard */
#define THINGSBOARD_HOST  "192.168.9.192"
#define THINGSBOARD_PORT  1883
#define THINGSBOARD_TOKEN "ofv7vsbetj3lat80za0t"

/* Wi-Fi Config */
#define WIFI_SSID      "SEU NOME DE REDE WIFI"
#define WIFI_PASSWORD  "SUA SENHA"

static struct net_mgmt_event_callback wifi_cb;
static struct net_mgmt_event_callback ipv4_cb;

static bool wifi_connected = false;
static bool dhcp_started = false;
static bool dhcp_ok = false;

static char gateway_ip[NET_IPV4_ADDR_LEN];

/* ===== IPv4 / DHCP callback ===== */
static void ipv4_event_handler( struct net_mgmt_event_callback *cb,
                                               uint64_t mgmt_event,
                                               struct net_if *iface
							                   )
{
    ARG_UNUSED(cb);

    if (mgmt_event == NET_EVENT_IPV4_DHCP_BOUND) {
        char ip_buf[NET_IPV4_ADDR_LEN];
        char mask_buf[NET_IPV4_ADDR_LEN];
        struct in_addr netmask;

        dhcp_ok = true;

        printk("Matched DHCP_BOUND\n");

        printk("IP: %s\n",
               net_addr_ntop(AF_INET,
                             &iface->config.dhcpv4.requested_ip,
                             ip_buf, sizeof(ip_buf)));

        net_addr_ntop(AF_INET,
                      &iface->config.ip.ipv4->gw,
                      gateway_ip, sizeof(gateway_ip));

        printk("Gateway: %s\n", gateway_ip);

        netmask = net_if_ipv4_get_netmask_by_addr(
            iface, &iface->config.dhcpv4.requested_ip);

        printk("Netmask: %s\n",
               net_addr_ntop(AF_INET,
                             &netmask,
                             mask_buf, sizeof(mask_buf)));

        printk("Lease time: %u s\n", iface->config.dhcpv4.lease_time);
    }
}

/* ===== Wi-Fi callback ===== */
static void wifi_event_handler(struct net_mgmt_event_callback *cb,
                                            uint64_t mgmt_event,
                                            struct net_if *iface)
{
    const struct wifi_status *status =
        (const struct wifi_status *)cb->info;

    printk("Wi-Fi event received: 0x%016llx\n",
           (unsigned long long)mgmt_event);

    if (mgmt_event == NET_EVENT_WIFI_CONNECT_RESULT) {
        printk("Matched CONNECT_RESULT\n");

        if (status == NULL) {
            printk("CONNECT_RESULT sem status\n");
            return;
        }

        printk("status=%d conn_status=%d disconn_reason=%d\n",
               status->status,
               status->conn_status,
               status->disconn_reason);

        if (status->status == 0) {
            printk("Wi-Fi connected successfully\n");
            wifi_connected = true;

            if (!dhcp_started) {
                printk("Starting DHCPv4...\n");
                net_dhcpv4_start(iface);
                dhcp_started = true;
            }
        } else {
            printk("Wi-Fi connection failed\n");
            wifi_connected = false;
        }

        return;
    }

    if (mgmt_event == NET_EVENT_WIFI_DISCONNECT_RESULT) {
        printk("Matched DISCONNECT_RESULT\n");

        if (status != NULL) {
            printk("status=%d conn_status=%d disconn_reason=%d\n",
                   status->status,
                   status->conn_status,
                   status->disconn_reason);
        } else {
            printk("DISCONNECT_RESULT sem status\n");
        }

        printk("Wi-Fi disconnected\n");
        wifi_connected = false;
        dhcp_started = false;
        dhcp_ok = false;
        return;
    }

    printk("Unhandled Wi-Fi event\n");
}

/*===TCP socket testing===*/
static int test_tcp_connect(const char *host, uint16_t port)
{
    int ret;
    int sock;
    struct sockaddr_in addr;

    memset(&addr, 0, sizeof(addr));
    addr.sin_family = AF_INET;
    addr.sin_port = htons(port);

    ret = zsock_inet_pton(AF_INET, host, &addr.sin_addr);
    if (ret != 1) {
        printk("inet_pton falhou para %s, ret=%d\n", host, ret);
        return -EINVAL;
    }

    sock = zsock_socket(AF_INET, SOCK_STREAM, 0);
    if (sock < 0) {
        printk("socket() falhou: %d errno=%d\n", sock, errno);
        return -errno;
    }

    printk("socket criado: %d\n", sock);
    printk("tentando conectar em %s:%u...\n", host, port);

    ret = zsock_connect(sock, (struct sockaddr *)&addr, sizeof(addr));
    if (ret < 0) {
        printk("connect() falhou: ret=%d errno=%d\n", ret, errno);
        zsock_close(sock);
        return -errno;
    }

    printk("TCP successfully conencted %s:%u\n", host, port);

    zsock_close(sock);
    printk("socket fechado\n");

    return 0;
}


/* ===== Wi-Fi connect request ===== */
static int wifi_connect(struct net_if *iface)
{
    struct wifi_connect_req_params cnx = {0};
    int ret;

    cnx.ssid = (const uint8_t *)WIFI_SSID;
    cnx.ssid_length = strlen(WIFI_SSID);

    cnx.psk = (const uint8_t *)WIFI_PASSWORD;
    cnx.psk_length = strlen(WIFI_PASSWORD);

    cnx.security = WIFI_SECURITY_TYPE_PSK;
    cnx.channel = WIFI_CHANNEL_ANY;
    cnx.band = WIFI_FREQ_BAND_UNKNOWN;
    cnx.mfp = WIFI_MFP_OPTIONAL;
    cnx.timeout = SYS_FOREVER_MS;

    printk("Sending Wi-Fi connect request...\n");

    ret = net_mgmt(NET_REQUEST_WIFI_CONNECT, iface, &cnx, sizeof(cnx));

    printk("net_mgmt(NET_REQUEST_WIFI_CONNECT) returned: %d\n", ret);
    return ret;
}

/* ===== Main ===== */
int main(void)
{
    struct net_if *iface;
    int ret;
    int tries;

    printk("=== MAIN STARTED ===\n");

    iface = net_if_get_default();
    if (iface == NULL) {
        printk("No default network interface\n");
        return -1;
    }

    printk("Default network interface found: %p\n", iface);

    net_mgmt_init_event_callback(&wifi_cb,
                                 wifi_event_handler,
                                 NET_EVENT_WIFI_CONNECT_RESULT |
                                 NET_EVENT_WIFI_DISCONNECT_RESULT);
    net_mgmt_add_event_callback(&wifi_cb);

    net_mgmt_init_event_callback(&ipv4_cb,
                                 ipv4_event_handler,
                                 NET_EVENT_IPV4_DHCP_BOUND);
    net_mgmt_add_event_callback(&ipv4_cb);

    ret = wifi_connect(iface);
    if (ret != 0) {
        printk("wifi_connect() failed: %d\n", ret);
        return ret;
    }

    printk("Waiting Wi-Fi connection...\n");
    tries = 0;
    while (!wifi_connected && tries < 20) {
        k_sleep(K_SECONDS(1));
        printk("still waiting Wi-Fi...\n");
        tries++;
    }

    if (!wifi_connected) {
        printk("Wi-Fi could not connect within the timeout\n");
        return -1;
    }

    printk("Waiting DHCP...\n");
    tries = 0;
    while (!dhcp_ok && tries < 20) {
        k_sleep(K_SECONDS(1));
        printk("still waiting DHCP...\n");
        tries++;
    }

    if (!dhcp_ok) {
        printk("DHCP could not assign IP within the timeout\n");
        return -1;
    }
    

    printk("Starting ping to gateway...\n");
    /* ping(gateway_ip, 4);*/
    ping(THINGSBOARD_HOST, 4);

k_sleep(K_SECONDS(1));

    printk("Starting ping to gateway...\n");
    /* ping(gateway_ip, 4);*/
    ping(THINGSBOARD_HOST, 4);

k_sleep(K_SECONDS(1));

    printk("Starting TCP test to ThingsBoard host...\n");
    ret = test_tcp_connect(THINGSBOARD_HOST, THINGSBOARD_PORT);
    printk("TCP test ret=%d\n", ret);

k_sleep(K_SECONDS(1));

    while (1) {
        printk("Sending telemetry to ThingsBoard...\n");

        ret = tb_mqtt_publish_telemetry(
            THINGSBOARD_HOST,
            THINGSBOARD_PORT,
            THINGSBOARD_TOKEN,
            "{\"temperature\":25,\"humidity\":60}"
        );

        if (ret == 0) {
            printk("Telemetry sent successfully\n");
        } else {
            printk("Telemetry failed (%d)\n", ret);
        }

        k_sleep(K_SECONDS(10));
    }

    return 0;
}
```

## src/ping.c
```c
#include <string.h>

#include <zephyr/kernel.h>
#include <zephyr/net/icmp.h>
#include <zephyr/net/net_if.h>
#include <zephyr/net/net_ip.h>
#include <zephyr/net/socket.h>
#include <zephyr/sys/printk.h>

static enum net_verdict icmp_echo_reply_handler(struct net_icmp_ctx *ctx,
						struct net_pkt *pkt,
						struct net_icmp_ip_hdr *ip_hdr,
						struct net_icmp_hdr *icmp_hdr,
						void *user_data)
{
	ARG_UNUSED(ctx);
	ARG_UNUSED(pkt);
	ARG_UNUSED(ip_hdr);
	ARG_UNUSED(icmp_hdr);

	if (user_data != NULL) {
		uint32_t sent_cycles = *(uint32_t *)user_data;
		uint32_t now_cycles = k_cycle_get_32();
		uint32_t delta_cycles = now_cycles - sent_cycles;

		printk("ICMP echo reply received, RTT cycles: %u\n", delta_cycles);
	} else {
		printk("ICMP echo reply received\n");
	}

	return NET_OK;
}

int ping(const char *ipv4_addr, uint8_t count)
{
	int ret;
	struct net_icmp_ctx icmp_context;
	struct net_if *iface;
	struct sockaddr_in dst_addr;

	iface = net_if_get_default();
	if (iface == NULL) {
		printk("No default network interface\n");
		return -ENODEV;
	}

	memset(&dst_addr, 0, sizeof(dst_addr));
	dst_addr.sin_family = AF_INET;
	dst_addr.sin_port = 0;

	ret = net_addr_pton(AF_INET, ipv4_addr, &dst_addr.sin_addr);
	if (ret < 0) {
		printk("Invalid IPv4 address: %s\n", ipv4_addr);
		return ret;
	}

	ret = net_icmp_init_ctx(&icmp_context,
				AF_INET,
				NET_ICMPV4_ECHO_REPLY,
				0,
				icmp_echo_reply_handler);
	if (ret < 0) {
		printk("Failed to init ping, err: %d\n", ret);
		return ret;
	}

	for (int i = 0; i < count; i++) {
		uint32_t cycles = k_cycle_get_32();

		ret = net_icmp_send_echo_request(&icmp_context,
						 iface,
						 (struct sockaddr *)&dst_addr,
						 NULL,
						 &cycles);
		if (ret < 0) {
			printk("Failed to send ping, err: %d\n", ret);
		} else {
			printk("Ping request %d sent to %s\n", i + 1, ipv4_addr);
		}

		k_sleep(K_SECONDS(2));
	}

	net_icmp_cleanup_ctx(&icmp_context);
	return 0;
}
```

## src/tb_mqtt.c
```c
#include <string.h>
#include <stdio.h>
#include <errno.h>
#include <stdbool.h>

#include <zephyr/kernel.h>
#include <zephyr/sys/printk.h>

#include <zephyr/net/socket.h>
#include <zephyr/net/mqtt.h>

#include "tb_mqtt.h"

#define MQTT_RX_BUFFER_SIZE 256
#define MQTT_TX_BUFFER_SIZE 256

static struct mqtt_client client;
static uint8_t rx_buffer[MQTT_RX_BUFFER_SIZE];
static uint8_t tx_buffer[MQTT_TX_BUFFER_SIZE];
static struct sockaddr_storage broker;

static volatile bool mqtt_connected = false;
static uint16_t next_message_id = 1;

static void mqtt_evt_handler(struct mqtt_client *const c,
                             const struct mqtt_evt *evt)
{
    ARG_UNUSED(c);

    switch (evt->type) {
    case MQTT_EVT_CONNACK:
        printk("MQTT EVT_CONNACK rc=%d\n", evt->param.connack.return_code);
        if (evt->param.connack.return_code == 0) {
            mqtt_connected = true;
        }
        break;

    case MQTT_EVT_DISCONNECT:
        printk("MQTT disconnected\n");
        mqtt_connected = false;
        break;

    default:
        printk("MQTT event: %d\n", evt->type);
        break;
    }
}

static int broker_init(const char *host, uint16_t port)
{
    struct sockaddr_in *broker4 = (struct sockaddr_in *)&broker;

    memset(&broker, 0, sizeof(broker));

    broker4->sin_family = AF_INET;
    broker4->sin_port = htons(port);

    if (zsock_inet_pton(AF_INET, host, &broker4->sin_addr) != 1) {
        printk("Invalid broker IPv4 address: %s\n", host);
        return -EINVAL;
    }

    return 0;
}

static int wait_for_connack(struct mqtt_client *client_ctx)
{
    struct zsock_pollfd fds[1];
    int ret;
    int tries = 0;

    fds[0].fd = client_ctx->transport.tcp.sock;
    fds[0].events = ZSOCK_POLLIN;
    fds[0].revents = 0;

    while (!mqtt_connected && tries < 20) {
        ret = zsock_poll(fds, 1, 500);
        if (ret < 0) {
            printk("zsock_poll failed: %d errno=%d\n", ret, errno);
            return ret;
        }

        if (ret > 0 && (fds[0].revents & ZSOCK_POLLIN)) {
            ret = mqtt_input(client_ctx);
            if (ret != 0) {
                printk("mqtt_input failed: %d\n", ret);
                return ret;
            }
        }

        ret = mqtt_live(client_ctx);
        if (ret != 0 && ret != -EAGAIN) {
            printk("mqtt_live failed: %d\n", ret);
            return ret;
        }

        tries++;
    }

    if (!mqtt_connected) {
        printk("Timeout waiting for MQTT CONNACK\n");
        return -ETIMEDOUT;
    }

    return 0;
}

int tb_mqtt_publish_telemetry(const char *host,
                              uint16_t port,
                              const char *access_token,
                              const char *json_payload)
{
    int ret;
    struct mqtt_publish_param param;
    struct mqtt_topic topic;

    struct mqtt_utf8 username = {
        .utf8 = (uint8_t *)access_token,
        .size = strlen(access_token),
    };

    struct mqtt_utf8 client_id = {
        .utf8 = (uint8_t *)"esp32s3-zephyr",
        .size = strlen("esp32s3-zephyr"),
    };

    mqtt_connected = false;

    ret = broker_init(host, port);
    if (ret < 0) {
        return ret;
    }

    mqtt_client_init(&client);

    client.broker = &broker;
    client.evt_cb = mqtt_evt_handler;
    client.client_id = client_id;
    client.user_name = &username;
    client.password = NULL;
    client.protocol_version = MQTT_VERSION_3_1_1;

    client.rx_buf = rx_buffer;
    client.rx_buf_size = sizeof(rx_buffer);
    client.tx_buf = tx_buffer;
    client.tx_buf_size = sizeof(tx_buffer);

    client.transport.type = MQTT_TRANSPORT_NON_SECURE;

    printk("Connecting MQTT to %s:%u\n", host, port);

    ret = mqtt_connect(&client);
    if (ret < 0) {
        printk("mqtt_connect failed: %d errno=%d\n", ret, errno);
        return ret;
    }

    ret = wait_for_connack(&client);
    if (ret < 0) {
        mqtt_disconnect(&client, NULL);
        return ret;
    }

    topic.topic = (struct mqtt_utf8) {
        .utf8 = (uint8_t *)"v1/devices/me/telemetry",
        .size = strlen("v1/devices/me/telemetry"),
    };
    topic.qos = MQTT_QOS_0_AT_MOST_ONCE;

    memset(&param, 0, sizeof(param));
    param.message.topic = topic;
    param.message.payload.data = (uint8_t *)json_payload;
    param.message.payload.len = strlen(json_payload);
    param.message_id = next_message_id++;
    param.dup_flag = 0;
    param.retain_flag = 0;

    ret = mqtt_publish(&client, &param);
    if (ret < 0) {
        printk("mqtt_publish failed: %d\n", ret);
        mqtt_disconnect(&client, NULL);
        return ret;
    }

    printk("Telemetry published: %s\n", json_payload);

    k_sleep(K_MSEC(300));
    mqtt_disconnect(&client, NULL);

    return 0;
}
```

## src/tb_mqtt.h
```c
#ifndef TB_MQTT_H
#define TB_MQTT_H

int tb_mqtt_publish_telemetry(const char *host,
                              uint16_t port,
                              const char *access_token,
                              const char *json_payload);

#endif
```
